## meta-agl-drm-lease/conf/layer.conf
```bitbake
# We have a conf and classes directory, add to BBPATH
BBPATH .= ":${LAYERDIR}"

# We have recipes-* directories, add to BBFILES
BBFILES += "${LAYERDIR}/recipes-*/*/*.bb ${LAYERDIR}/recipes-*/*/*.bbappend"

BBFILE_COLLECTIONS += "agl-drm-lease"
BBFILE_PATTERN_agl-drm-lease = "^${LAYERDIR}/"
BBFILE_PRIORITY_agl-drm-lease = "10"

# This should only be incremented on significant changes that will
# cause compatibility issues with other layers
LAYERVERSION_agl-drm-lease = "1"

LAYERDEPENDS_agl-drm-lease = "core"
LAYERSERIES_COMPAT_agl-drm-lease = "dunfell"
```

## meta-agl-lxc/conf/layer.conf
```bitbake
# We have a conf and classes directory, add to BBPATH
BBPATH =. "${LAYERDIR}:"

# We have recipes-* directories, add to BBFILES
BBFILES += "${LAYERDIR}/recipes-*/*/*.bb \
            ${LAYERDIR}/recipes-*/*/*.bbappend"

BBFILE_COLLECTIONS += "aglcontainermc"
BBFILE_PATTERN_aglcontainermc = "^${LAYERDIR}/"
BBFILE_PRIORITY_aglcontainermc = "100"
LAYERSERIES_COMPAT_aglcontainermc = "dunfell"
```

## meta-agl-ros2/conf/layer.conf
```bitbake
# We have a conf and classes directory, add to BBPATH
BBPATH =. "${LAYERDIR}:"

# We have recipes-* directories, add to BBFILES
BBFILES += "${LAYERDIR}/recipes-*/*/*.bb \
            ${LAYERDIR}/recipes-*/*/*.bbappend"

BBFILE_COLLECTIONS += "aglros2"
BBFILE_PATTERN_aglros2 = "^${LAYERDIR}/"
BBFILE_PRIORITY_aglros2 = "70"

LAYERSERIES_COMPAT_aglros2 = "kirkstone"
```

## meta-agl-telemetry/conf/layer.conf
```bitbake
# We have a conf and classes directory, add to BBPATH
BBPATH .= ":${LAYERDIR}"

# We have recipes-* directories, add to BBFILES
BBFILES += "${LAYERDIR}/recipes-*/*/*.bb \
	${LAYERDIR}/recipes-*/*/*.bbappend"

BBFILE_COLLECTIONS += "meta-agl-telemetry"
BBFILE_PATTERN_meta-agl-telemetry = "^${LAYERDIR}/"
BBFILE_PRIORITY_meta-agl-telemetry = "11"

LAYERSERIES_COMPAT_meta-agl-telemetry = "thud"
```

## meta-audio-4a-framework/conf/layer.conf
```bitbake
# We have a conf and classes directory, add to BBPATH
BBPATH .= ":${LAYERDIR}"

# Fix for SPEC-1588
# Let us add layer-specific bbappends which are only applied when that
# layer is included in our configuration -
# e.g. only add layers if a bsp is present.
# This is based on the BBFILE_COLLECTIONS name of the layer.
BBFILES += "${@' '.join('${LAYERDIR}/meta-%s/recipes*/*/*.bbappend' % layer \
               for layer in BBFILE_COLLECTIONS.split())}"
BBFILES += "${@' '.join('${LAYERDIR}/meta-%s/recipes*/*/*.bb' % layer \
               for layer in BBFILE_COLLECTIONS.split())}"


# We have recipes-* directories, add to BBFILES
BBFILES += "${LAYERDIR}/recipes-*/*/*.bb \
	${LAYERDIR}/recipes-*/*/*.bbappend"

BBFILE_COLLECTIONS += "4a-framework"
BBFILE_PATTERN_4a-framework = "^${LAYERDIR}/"
BBFILE_PRIORITY_4a-framework = "8"
```

## meta-egvirt/conf/machine/include/virtio.inc
```bitbake
PREFERRED_PROVIDER_virtual/egl ?= "mesa"
PREFERRED_PROVIDER_virtual/libgl ?= "mesa"
PREFERRED_PROVIDER_virtual/libgles1 ?= "mesa"
PREFERRED_PROVIDER_virtual/libgles2 ?= "mesa"

MACHINE_FEATURES = "alsa usbgadget screen vfat"

MACHINEOVERRIDES =. "virtio-all:"

IMAGE_FSTYPES += "tar.bz2 ext4"

# Don't include kernels in standard images
RDEPENDS_${KERNEL_PACKAGE_NAME}-base = ""

# Use a common kernel recipe for all VirtIO machines
PREFERRED_PROVIDER_virtual/kernel ??= "linux-yocto"

EXTRA_IMAGEDEPENDS += "qemu-native qemu-helper-native"

IMAGE_CLASSES += "qemuboot"

# most driver fails to compile
MOST_DRIVERS ?= ""
```

## meta-egvirt/conf/machine/virtio-aarch64.conf
```bitbake
#@TYPE: Machine
#@NAME: VirtIO ARMv8 machine
#@DESCRIPTION: Machine configuration for running an ARMv8 system on VirtIO based platform

require conf/machine/include/arm/arch-armv8a.inc
require conf/machine/include/virtio.inc

KERNEL_IMAGETYPE = "Image"

SERIAL_CONSOLES ?= "115200;ttyAMA0 115200;hvc0"
SERIAL_CONSOLES_CHECK = "${SERIAL_CONSOLES}"

# For runqemu
QB_SYSTEM_NAME = "qemu-system-aarch64"
QB_MACHINE = "-machine virt"
QB_CPU = "-cpu cortex-a57"
QB_CPU_KVM = "-cpu host -machine gic-version=3"
QB_MEM = "-m 2048"
# Standard Serial console
QB_KERNEL_CMDLINE_APPEND = "console=ttyAMA0"
# Ensure virtio-mmio support VirtIO 1.0 required by virtio-gpu
QB_OPT_APPEND = "-global virtio-mmio.force-legacy=false"
# TODO: upstream to OE-core runqemu
QB_OPT_APPEND += "-device virtio-gpu-device -display gtk,gl=on -show-cursor"
# Virtio input
QB_OPT_APPEND += "-device virtio-mouse-device -device virtio-keyboard-device"
# Add the 'virtio-rng-device' device otherwise the guest may run out of entropy
QB_OPT_APPEND += "-object rng-random,filename=/dev/urandom,id=rng0 -device virtio-rng-device,rng=rng0"
# Virtio Networking support
QB_TAP_OPT = "-netdev tap,id=net0,ifname=@TAP@,script=no,downscript=no"
QB_NETWORK_DEVICE = "-device virtio-net-device,netdev=net0,mac=@MAC@"
# Virtio block device
QB_ROOTFS_OPT = "-drive id=disk0,file=@ROOTFS@,if=none,format=raw -device virtio-blk-device,drive=disk0"
# Virtio serial console
QB_SERIAL_OPT = "-device virtio-serial-device -chardev null,id=virtcon -device virtconsole,chardev=virtcon"
QB_TCPSERIAL_OPT = "-device virtio-serial-device -chardev socket,id=virtcon,port=@PORT@,host=127.0.0.1 -device virtconsole,chardev=virtcon"
```

## meta-gstrecorder-rcar-gen3/conf/layer.conf
```bitbake
# We have a conf and classes directory, add to BBPATH
BBPATH =. "${LAYERDIR}:"

# We have recipes-* directories, add to BBFILES
BBFILES += "${LAYERDIR}/recipes-*/*/*.bb \
            ${LAYERDIR}/recipes-*/*/*.bbappend"

BBFILE_COLLECTIONS += "gstrecorder-rcar-gen3"
BBFILE_PATTERN_gstrecorder-rcar-gen3 = "^${LAYERDIR}/"
BBFILE_PRIORITY_gstrecorder-rcar-gen3 = "7"
```

## meta-oem-extra-libs/conf/layer.conf
```bitbake
# We have a conf and classes directory, add to BBPATH
BBPATH .= ":${LAYERDIR}"

# We have recipes-* directories, add to BBFILES
BBFILES += "${LAYERDIR}/recipes-*/*/*.bb \
	${LAYERDIR}/recipes-*/*/*.bbappend"

BBFILE_COLLECTIONS += "oem-extra-libs"
BBFILE_PATTERN_oem-extra-libs = "^${LAYERDIR}/"
BBFILE_PRIORITY_oem-extra-libs = "7"
```

## meta-renesas-kernel/conf/layer.conf
```bitbake
# We have a conf and classes directory, add to BBPATH
BBPATH =. "${LAYERDIR}:"

# We have recipes-* directories, add to BBFILES
BBFILES += "${LAYERDIR}/recipes-*/*/*.bb \
            ${LAYERDIR}/recipes-*/*/*.bbappend"

BBFILE_COLLECTIONS += "renesas-kernel"
BBFILE_PATTERN_renesas-kernel = "^${LAYERDIR}/"
BBFILE_PRIORITY_renesas-kernel = "7"
```

## meta-speech-framework/conf/layer.conf
```bitbake
# We have a conf and classes directory, add to BBPATH
BBPATH .= ":${LAYERDIR}"

# We have recipes-* directories, add to BBFILES
BBFILES += "${LAYERDIR}/recipes-*/*/*.bb \
	${LAYERDIR}/recipes-*/*/*.bbappend"

BBFILE_COLLECTIONS += "speech-framework"
BBFILE_PATTERN_speech-framework = "^${LAYERDIR}/"
BBFILE_PRIORITY_speech-framework = "8"
```
